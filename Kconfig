## workspace/app/Kconfig
```kconfig
# SPDX-FileCopyrightText: 2026 roolrz
# SPDX-License-Identifier: Apache-2.0

menu "System / Applications"
source "app/componentctl/Kconfig"
source "app/coreutils/Kconfig"
source "app/editor/Kconfig"
source "app/free/Kconfig"
source "app/grep/Kconfig"
source "app/handle/Kconfig"
source "app/journalctl/Kconfig"
source "app/ldd/Kconfig"
source "app/less/Kconfig"
source "app/memstat/Kconfig"
source "app/mount/Kconfig"
source "app/perf/Kconfig"
source "app/ps/Kconfig"
source "app/shell/Kconfig"
source "app/top/Kconfig"
source "app/umount/Kconfig"
source "app/vmm/Kconfig"

endmenu
```

## workspace/svc/Kconfig
```kconfig
# SPDX-FileCopyrightText: 2026 roolrz
# SPDX-License-Identifier: Apache-2.0

menu "System / Services"
source "svc/bootstrap-retire/Kconfig"
source "svc/component-manager/Kconfig"
source "svc/console-raw/Kconfig"
source "svc/fs-backend/Kconfig"
source "svc/fs-erofs/Kconfig"
source "svc/fs-fat/Kconfig"
source "svc/io-runtime/Kconfig"
source "svc/journal/Kconfig"
source "svc/session-manager/Kconfig"
source "svc/system-startup/Kconfig"
source "svc/terminal-service/Kconfig"
source "svc/vm-manager/Kconfig"
source "svc/vm-runtime/Kconfig"

endmenu
```
